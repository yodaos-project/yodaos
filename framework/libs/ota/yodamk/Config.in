## framework/libs/ota/yodamk/Config.in
```kconfig
config ROKIDOS_BOARDCONFIG_STORAGE_DEVICETYPE
    int "board storage type device id"
    help
        0-mmc,1-nand
    default 1

config YODABASE_RECOVERY_BOOT
    bool "yodaos boot into recovery mode for ota"
    default n

config OTA_AUTH
    bool "support ota image signature authentication"
    default n
```

## framework/libs/player/yodamk/Config.in
```kconfig
config BR2_PACKAGE_LIBRPLAYER
        bool "rokid librplayer sdk"
        select BR2_PACKAGE_FFMPEG
        select BR2_PACKAGE_SDL2
	select BR2_PACKAGE_PULSEAUDIO
	default y
```

## hardware/yodamk/android-hardware/Config.in
```kconfig
menu "Hardware Layer Solutions"
	config LED_HAL_PWM
          bool "Led HAL via PWM"
          default n

	config LED_HAL_VSP
          bool "Led HAL via VSP"
          default n

	config LED_HAL_I2C
          bool "Led HAL via I2C"
          default n

	config LED_HAL_YODASTAGE
          bool "Led HAL via YODASTAGE"
          default n

	config LED_HAL_GPIO
          bool "GPIO Led used"
          default n

	config BOARD_LED_NUMS
		int "pwm led nums used"
		default 5

	config POWER_HAL
		bool "power manager HAL"
		default n

	config WIFI_HAL
		bool "wifi manager HAL"
		default n

  config ETHNET_HAL
		bool "ethnet manager HAL"
		default n

	config MIC_ARRAY_HAL_VSP
		bool "mic array via vsp I/F"
		default n

	config MIC_ARRAY_HAL_PCM
		bool "mic array via pcm I/F"
		default n

	config KENOBI_MODE
		bool "mic array using kenobi mode instead of active mode"
		default n

	config BOARD_MIC_CHANNEL
		int "mic nums used"
		default 8

	config BOARD_MIC_SAMPLE_RATE
		int "mic sample rate used"
		default 48000

	config BOARD_MIC_BIT_FORMAT
		int "mic bit format"
		default 32

	config ROKIDOS_BOARDCONFIG_SOUND_CARDID
		int "sound card id for pcm device"
		default 0

	config ROKIDOS_BOARDCONFIG_CAPTURE_DEVICEID
		int "capture device id for pcm device"
		default 3

	config BLUETOOTH_USE_BLUEZ
		bool "bluetooth use bluez"
		default n

	config BLUETOOTH_USE_BSA_AMPAK
		bool "bluetooth use bsa ampak"
		default n

	config BLUETOOTH_USE_BSA_CYPRESS
		bool "bluetooth use bsa cypress"
		default n
    config MODEM_HAL_TTY 
		bool "Modem HAL TTY"
		default n

	config BOARD_MODEM_TTY_DEBUG
		bool "modem tty debug"
 		depends on MODEM_HAL_TTY
		default n 

	config BOARD_MODEM_TTY_BAUD
		int "default modem tty baudrate"
 		depends on MODEM_HAL_TTY
		default "115200"

	config BOARD_MODEM_TTY_DEV
		string "default modem tty device name"
 		depends on MODEM_HAL_TTY
		default "/dev/ttyACM1"

endmenu
```

## hardware/yodamk/bcmdhd_fw/Config.in
```kconfig
menu "Broadcom wifi firmware selection"
     comment "brcmd hardware"

     config BRCMD_AP6255
          bool "wifi Broadcom firmware 6255"
          default n

     config BRCMD_AP6236
          bool "wifi Broadcom firmware 6236"
          default n

     config BRCMD_NB197
          bool "wifi Broadcom firmware cypress nb197"
          default n

     config BRCMD_TEST
          bool "wifi Broadcom hardware test"
          default n

     config K18_WIFI_FIRMWARE_SELECTION
          bool "Select wifi firmware for K18 platform"
          default n

     config A113_WIFI_FIRMWARE_SELECTION
          bool "Select wifi firmware for A113 platform"
          default n
endmenu
```

## openwrt/configs/k18_defconfig
```kconfig
CONFIG_TARGET_leo=y
CONFIG_TARGET_leo_k18_universal=y
CONFIG_TARGET_leo_k18_universal_LEO_K18_UNIVERSAL=y
CONFIG_DEVEL=y
CONFIG_TOOLCHAINOPTS=y
CONFIG_BINARY_FOLDER="$(TOPDIR)/bin/leo-k18-universal"
CONFIG_EXTERNAL_KERNEL_CONFIG=y
CONFIG_EXTERNAL_KERNEL_TREE="$(TOPDIR)/../kernel/k18/4.4"
CONFIG_EXTERNAL_UBOOT_TREE="$(TOPDIR)/../uboot/k18/uboot"
CONFIG_GLIBC_USE_VERSION_2_22=y
CONFIG_GLIBC_VERSION="2.22"
CONFIG_GLIBC_VERSION_2_22=y
CONFIG_KERNEL_ARM_PMU=y
CONFIG_KERNEL_BLK_CGROUP=y
CONFIG_KERNEL_CGROUPS=y
CONFIG_KERNEL_CGROUP_DEVICE=y
CONFIG_KERNEL_CGROUP_FREEZER=y
CONFIG_KERNEL_CGROUP_PERF=y
CONFIG_KERNEL_CGROUP_PIDS=y
CONFIG_KERNEL_FREEZER=y
CONFIG_KERNEL_IP_PNP=y
CONFIG_KERNEL_IP_PNP_DHCP=y
CONFIG_KERNEL_NETPRIO_CGROUP=y
CONFIG_KERNEL_NET_CLS_CGROUP=y
CONFIG_KERNEL_NFS_FS=y
CONFIG_KERNEL_NFS_V2=y
CONFIG_KERNEL_NFS_V3=y
CONFIG_KERNEL_PERF_EVENTS=y
CONFIG_KERNEL_PROFILING=y
CONFIG_KERNEL_ROOT_NFS=y
CONFIG_KERNEL_PROC_PAGE_MONITOR=y
CONFIG_LIBC="glibc"
CONFIG_LIBC_USE_GLIBC=y
# CONFIG_LIBC_USE_MUSL is not set
CONFIG_LIBC_VERSION="2.22"
CONFIG_PACKAGE_SDL2=y
CONFIG_PACKAGE_activation=y
CONFIG_PACKAGE_activation-cust=y
CONFIG_PACKAGE_pstore=y
CONFIG_PACKAGE_qqmusic=y
CONFIG_PACKAGE_adbd=y
# CONFIG_PACKAGE_aicore is not set
# CONFIG_PACKAGE_alab-libs is not set
CONFIG_PACKAGE_gxnpu=y
CONFIG_PACKAGE_ai-libs-common=y
CONFIG_AI_KAMINO=y
CONFIG_PACKAGE_alsa-utils=y
CONFIG_PACKAGE_android-fw-native=y
CONFIG_PACKAGE_android-hardware=y
CONFIG_LED_HAL_VSP=y
CONFIG_BOARD_LED_NUMS=12
CONFIG_PACKAGE_android-system-core=y
# CONFIG_PACKAGE_appmedia is not set
CONFIG_WIFI_BT_AMPAK=y
CONFIG_PACKAGE_AMPAK_6236=y
CONFIG_PACKAGE_AMPAK_6236_BY_BSA=y
CONFIG_PACKAGE_blis=y
CONFIG_PACKAGE_dbus-cpp=y
CONFIG_PACKAGE_dbus-utils=y
CONFIG_PACKAGE_dhcpcd=y
# CONFIG_PACKAGE_eesen-master is not set
CONFIG_PACKAGE_factory=y
CONFIG_PACKAGE_fftw3f=y
# CONFIG_PACKAGE_gxcoreapi is not set
# CONFIG_PACKAGE_gxmpd is not set
CONFIG_PACKAGE_homebase-bootstrap=y
CONFIG_PACKAGE_htop=y
CONFIG_PACKAGE_input-event=y
CONFIG_PACKAGE_iperf=y
#CONFIG_PACKAGE_iperf3=y
CONFIG_PACKAGE_iw=y
CONFIG_PACKAGE_iwinfo=y
# CONFIG_PACKAGE_jansson is not set
CONFIG_PACKAGE_kmod-sound-soc-gx-codec=y
CONFIG_PACKAGE_kmod-sound-soc-nationalchip=y
CONFIG_PACKAGE_kmod-sound-soc-sma1301=y
CONFIG_PACKAGE_libapr=y
CONFIG_PACKAGE_libaprutil=y
CONFIG_PACKAGE_libarchive=y
# CONFIG_PACKAGE_libaudiofile is not set
CONFIG_PACKAGE_libbfd=y
CONFIG_PACKAGE_libconfig=y
# CONFIG_PACKAGE_libdb47 is not set
# CONFIG_PACKAGE_libfaad2 is not set
# CONFIG_PACKAGE_libflac is not set
# CONFIG_PACKAGE_libgdbm is not set
# CONFIG_PACKAGE_libid3tag is not set
CONFIG_PACKAGE_libiwinfo=y
CONFIG_PACKAGE_liblzma=y
# CONFIG_PACKAGE_libmad is not set
# CONFIG_PACKAGE_libmms is not set
# CONFIG_PACKAGE_libmpdclient is not set
# CONFIG_PACKAGE_libogg is not set
CONFIG_PACKAGE_libopus=y
CONFIG_PACKAGE_libpcre=y
CONFIG_PACKAGE_librokid-bcmdhd-bt=y
CONFIG_PACKAGE_librplayer=y
CONFIG_PACKAGE_libssp=y
CONFIG_PACKAGE_libthread-db=y
CONFIG_PACKAGE_libubootenv=y
# CONFIG_PACKAGE_libupnp is not set
CONFIG_PACKAGE_libusb-1.0=y
CONFIG_PACKAGE_libuuid=y
# CONFIG_PACKAGE_libvorbis is not set
# CONFIG_PACKAGE_libvorbisidec is not set
# CONFIG_PACKAGE_libxml2 is not set
# CONFIG_PACKAGE_mpc is not set
CONFIG_PACKAGE_net_manager=y
CONFIG_PACKAGE_openfst=y
# CONFIG_PACKAGE_openmaxIL is not set
CONFIG_PACKAGE_ota_unpack=y
# CONFIG_PACKAGE_poco-1.7.8p2-all is not set
CONFIG_PACKAGE_procps-ng=y
CONFIG_PACKAGE_procps-ng-free=y
CONFIG_PACKAGE_procps-ng-kill=y
CONFIG_PACKAGE_procps-ng-pgrep=y
CONFIG_PACKAGE_procps-ng-pkill=y
CONFIG_PACKAGE_procps-ng-pmap=y
CONFIG_PACKAGE_procps-ng-ps=y
CONFIG_PACKAGE_procps-ng-pwdx=y
CONFIG_PACKAGE_procps-ng-skill=y
CONFIG_PACKAGE_procps-ng-slabtop=y
CONFIG_PACKAGE_procps-ng-snice=y
CONFIG_PACKAGE_procps-ng-tload=y
CONFIG_PACKAGE_procps-ng-top=y
CONFIG_PACKAGE_procps-ng-uptime=y
CONFIG_PACKAGE_procps-ng-vmstat=y
CONFIG_PACKAGE_procps-ng-w=y
CONFIG_PACKAGE_procps-ng-watch=y
CONFIG_PACKAGE_property=y
CONFIG_PACKAGE_property_service=y
CONFIG_PACKAGE_pulseaudio-profiles=y
CONFIG_PACKAGE_pulseaudio-tools=y
# CONFIG_PACKAGE_python is not set
# CONFIG_PACKAGE_python-base is not set
# CONFIG_PACKAGE_python-codecs is not set
# CONFIG_PACKAGE_python-compiler is not set
# CONFIG_PACKAGE_python-ctypes is not set
# CONFIG_PACKAGE_python-db is not set
# CONFIG_PACKAGE_python-decimal is not set
# CONFIG_PACKAGE_python-distutils is not set
# CONFIG_PACKAGE_python-email is not set
# CONFIG_PACKAGE_python-gdbm is not set
# CONFIG_PACKAGE_python-light is not set
# CONFIG_PACKAGE_python-logging is not set
# CONFIG_PACKAGE_python-multiprocessing is not set
# CONFIG_PACKAGE_python-ncurses is not set
# CONFIG_PACKAGE_python-openssl is not set
# CONFIG_PACKAGE_python-pydoc is not set
# CONFIG_PACKAGE_python-sqlite3 is not set
# CONFIG_PACKAGE_python-unittest is not set
# CONFIG_PACKAGE_python-xml is not set
CONFIG_PACKAGE_rkamsex=y
# CONFIG_PACKAGE_screen is not set
# CONFIG_PACKAGE_senseflow is not set
CONFIG_PACKAGE_shadow-node=y
# CONFIG_PACKAGE_sptk-3.9 is not set
CONFIG_PACKAGE_tinyalsa=y
CONFIG_PACKAGE_uboot-leo-k18-universal=y
CONFIG_PACKAGE_uclibcxx=y
#CONFIG_PACKAGE_usbutils=y
CONFIG_PACKAGE_vol_ctrl=y
CONFIG_PACKAGE_wget=y
CONFIG_PACKAGE_wifi_monitor=y
CONFIG_PACKAGE_wireless-tools=y
CONFIG_PACKAGE_wpa-cli=y
CONFIG_PACKAGE_wpa-supplicant=y
CONFIG_PACKAGE_wpa_ctrl=y
CONFIG_PACKAGE_libeloop_mini=y
# CONFIG_PACKAGE_udp_multicast=y
CONFIG_PACKAGE_zeromq=y
CONFIG_PACKAGE_zoneinfo-asia=y
CONFIG_PACKAGE_zoneinfo-core=y
CONFIG_SSP_SUPPORT=y
CONFIG_STRIP_ARGS="--strip-all"
CONFIG_TARGET_EXT4_MAXINODE=7000
CONFIG_TARGET_EXT4_RESERVED_PCT=1
CONFIG_TARGET_ROOTFS_SQUASHFS=y
CONFIG_TARGET_SQUASHFS_BLOCK_SIZE=32
CONFIG_TARGET_SUFFIX="gnueabi"
CONFIG_TARGET_UBIFS_COMPRESSION_XZ=y
# CONFIG_TARGET_UBIFS_COMPRESSION_ZLIB is not set
CONFIG_TARGET_APP_UBIFS=y
# CONFIG_TARGET_UBIFS_FREE_SPACE_FIXUP is not set
CONFIG_USE_GLIBC=y
CONFIG_USE_STRIP=y
CONFIG_PACKAGE_vsp=y
CONFIG_VSP_DEFCONFIG="k18_universal_defconfig"
CONFIG_WPA_SUPPLICANT_INTERNAL=y
CONFIG_PACKAGE_bash=y
CONFIG_PACKAGE_boost=y
# CONFIG_PACKAGE_boost-atomic is not set
# CONFIG_PACKAGE_boost-chrono is not set
CONFIG_PACKAGE_boost-container=y
# CONFIG_PACKAGE_boost-context is not set
# CONFIG_PACKAGE_boost-coroutine is not set
# CONFIG_PACKAGE_boost-date_time is not set
# CONFIG_PACKAGE_boost-fiber is not set
# CONFIG_PACKAGE_boost-filesystem is not set
# CONFIG_PACKAGE_boost-graph is not set
# CONFIG_PACKAGE_boost-iostreams is not set
# CONFIG_PACKAGE_boost-log is not set
# CONFIG_PACKAGE_boost-math is not set
# CONFIG_PACKAGE_boost-program_options is not set
# CONFIG_PACKAGE_boost-random is not set
# CONFIG_PACKAGE_boost-regex is not set
# CONFIG_PACKAGE_boost-serialization is not set
# CONFIG_PACKAGE_boost-signals is not set
# CONFIG_PACKAGE_boost-system is not set
# CONFIG_PACKAGE_boost-thread is not set
# CONFIG_PACKAGE_boost-timer is not set
# CONFIG_PACKAGE_boost-wave is not set
CONFIG_PACKAGE_libffmpeg-audio-dec=y
# CONFIG_PACKAGE_libffmpeg-full is not set
# CONFIG_USE_LIBSTDCXX is not set
CONFIG_USE_UCLIBCXX=y
# CONFIG_boost-coroutine2 is not set
# CONFIG_boost-graph-parallel is not set
# CONFIG_boost-libs-all is not set
CONFIG_boost-runtime-shared=y
# CONFIG_boost-shared-libs is not set
CONFIG_boost-static-and-shared-libs=y
# CONFIG_boost-static-libs is not set
# CONFIG_boost-test-pkg is not set
# CONFIG_boost-use-name-tags is not set
# CONFIG_boost-variant-debug is not set
# CONFIG_boost-variant-profile is not set
CONFIG_boost-variant-release=y
```

## openwrt/feeds/management/libnetconf/Config.in
```kconfig
menu "Configuration"
	depends on PACKAGE_libnetconf
        
	config LIBNETCONF_ENABLE_DNSSEC
		bool "Enable support for SSHFP retrieval using DNSSEC for SSH"
		depends on @BROKEN
		default n

	config LIBNETCONF_ENABLE_NOTIFICATIONS
		bool "Enable support for NETCONF Notifications (RFC 5277)"
		default y

        config LIBNETCONF_ENABLE_TLS
                bool "Enable support for NETCONF over TLS using OpenSSL"
                default y

	config LIBNETCONF_ENABLE_URL
		bool "Enable support of NETCONF URL Capability (RFC 6241)"
		default y

	config LIBNETCONF_ENABLE_VALIDATION
		bool "Enable support for configuration data validation (RFC 6241)"
		default y

	config LIBNETCONF_ENABLE_YANG_SCHEMAS
		bool "Enable support for YANG format in <get-schema> operation"
		default y

	config LIBNETCONF_USE_LIBSSH
		bool "Use libssh library for SSH transport"
		default y
		help
			If this config is selected, the libssh library is 
			used for SSH transport. Otherwise the system SSH 
			client is used.

	config LIBNETCONF_WORKING_DIR
		string "NETCONF working directory"
		default '/usr/share/libnetconf/'
		help
			Path to a working directory of libnetconf, where all
			the system files are stored, the default value is
			/usr/share/libnetconf/
endmenu
```

## openwrt/feeds/telephony/net/asterisk-11.x/Config.in
```kconfig
menu "Advanced configuration"
	depends on PACKAGE_asterisk11

config ASTERISK11_LOW_MEMORY
	bool "Optimize Asterisk 11 for low memory usage"
	default n
	help
	  Warning: this feature is known to cause problems with some modules.
	  Disable it if you experience problems like segmentation faults.

endmenu
```

## openwrt/feeds/telephony/net/asterisk-13.x/Config.in
```kconfig
menu "Advanced configuration"
	depends on PACKAGE_asterisk13

config ASTERISK13_LOW_MEMORY
	bool "Optimize Asterisk 13 for low memory usage"
	default n
	help
	  Warning: this feature is known to cause problems with some modules.
	  Disable it if you experience problems like segmentation faults.

endmenu
```

## openwrt/feeds/telephony/net/freeswitch-stable/Config.in
```kconfig
menu "Advanced configuration"
	depends on PACKAGE_freeswitch-stable

config FS_STABLE_WITH_DEBUG
	bool "Compile with debug information"
	default n
	help
	  Enable extra debug codepaths, like asserts and extra output. If you
	  want to get meaningful backtraces see
	  https://wiki.openwrt.org/doc/devel/debugging for starting points.

config FS_STABLE_WITH_FREETYPE
	bool "Compile with FreeType support"
	default y if x86_64
	help
	  Add FreeType support to FreeSWITCH

config FS_STABLE_WITH_LIBEDIT
	bool "Compile with libedit support"
	default y
	help
	  Compile with libedit support to enable command-line history editing
	  and curses functionality. Of course this feels nicer when interacting
	  with FreeSWITCH (without it it doesn't feel very interactive at all),
	  but it adds additional dependencies (libedit, libncursesw, terminfo).

config FS_STABLE_WITH_LIBYUV
	bool "Compile with libyuv support"
	default y if x86_64
	help
	  Add libyuv support to FreeSWITCH

config FS_STABLE_WITH_ODBC
	bool "Compile with ODBC support"
	default y if x86_64
	help
	  Enable ODBC support.

config FS_STABLE_WITH_PGSQL
	bool "Compile with PGSQL support"
	default y if x86_64
	help
	  Enable PostgreSQL support.

config FS_STABLE_WITH_PNG
	bool "Compile with PNG support"
	default y if x86_64
	help
	  Add PNG support to FreeSWITCH

config FS_STABLE_WITH_SRTP
	bool "Compile with SRTP support"
	default y
	help
	  Compile with SRTP support.

config FS_STABLE_WITH_V8
	bool "Compile with V8 support"
	depends on arm||i386||mipsel||x86_64
	default y if x86_64
	help
	  The sole purpose of this symbol is to prevent mod_v8 from being built
	  by the build bots. Currently the only exception is x86_64. The build is
	  time-consuming and the module is quite large, making it an unlikely
	  choice for devices with limited resources.

	  If you want mod_v8 to become available, select 'y'.

config FS_STABLE_WITH_V8_SNAPSHOT
	bool "Include heap snapshot"
	depends on FS_STABLE_WITH_V8
	default n
	help
	  V8 can be built with a heap snapshot for faster initialization. Default
	  is 'n' because of seemingly random segmentation faults observed when
	  generating the snapshot.

	  Only select 'y' if you know what you are doing.

config FS_STABLE_WITH_VPX
	bool "Compile with VPx support"
	depends on FS_STABLE_WITH_LIBYUV
	default y if x86_64
	help
	  Compile with VPx video codec support

config FS_STABLE_WITH_ZRTP
	bool "Compile with ZRTP support"
	depends on aarch64||aarch64_be||arm||armeb||i386||mips||mips64||mips64el||mipsel||powerpc||powerpc64||powerpcle||sparc||x86_64
	default y if x86_64
	help
	  Compile with ZRTP support.

config FS_STABLE_WITH_MODCONF
	bool "Include module examples"
	default y if x86_64
	help
	  Some modules include examples in their source directory, e.g. xml
	  snippets. Select y to include them.

endmenu
```
